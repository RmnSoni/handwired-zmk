## boards/shields/dw36/Kconfig.defconfig
```kconfig
# Copyright (c) 2020 The ZMK Contributors
# SPDX-License-Identifier: MIT

if SHIELD_DW36_LEFT

config ZMK_KEYBOARD_NAME
    default "DW36"

config ZMK_SPLIT_ROLE_CENTRAL
    default y

endif

if SHIELD_DW36_RIGHT

config ZMK_KEYBOARD_NAME
    default "DW36"

endif

if SHIELD_DW36_LEFT || SHIELD_DW36_RIGHT

config ZMK_SPLIT
    default y

endif
```

## boards/shields/dw36/Kconfig.shield
```kconfig
# Copyright (c) 2020 The ZMK Contributors
# SPDX-License-Identifier: MIT

config SHIELD_DW36_LEFT
    def_bool $(shields_list_contains,dw36_left)

config SHIELD_DW36_RIGHT
    def_bool $(shields_list_contains,dw36_right)
```
